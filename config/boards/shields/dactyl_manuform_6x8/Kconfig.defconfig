## config/boards/shields/dactyl_manuform_6x8/Kconfig.defconfig
```kconfig
if SHIELD_DACTYL_MANUFORM_6x8_LEFT

    config ZMK_KEYBOARD_NAME
        default "Dactyl Manuform"

    config ZMK_SPLIT_BLE_ROLE_CENTRAL
        default y

endif

if SHIELD_DACTYL_MANUFORM_6x8_RIGHT || SHIELD_DACTYL_MANUFORM_6x8_LEFT


    config ZMK_SPLIT
        default y

    CONFIG_ZMK_SPLIT_BLE_CENTRAL_BATTERY_LEVEL_FETCHING=y
    CONFIG_ZMK_SPLIT_BLE_CENTRAL_BATTERY_LEVEL_PROXY=y

endif
```
